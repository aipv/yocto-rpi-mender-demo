## meta-rpi-demo/conf/layer.conf
```bitbake
BBPATH .= ":${LAYERDIR}"

BBFILES += "${LAYERDIR}/recipes-*/*/*.bb \
            ${LAYERDIR}/recipes-*/*/*.bbappend"

BBFILE_COLLECTIONS += "rpidemo"
BBFILE_PATTERN_rpidemo := "^${LAYERDIR}/"
BBFILE_PRIORITY_rpidemo = "6"

LAYERDEPENDS_rpidemo = "core openembedded-layer"
LAYERSERIES_COMPAT_rpidemo = "scarthgap"
```
